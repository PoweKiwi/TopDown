/*
Start date:3/9/2019
action game/shop sim
Made by Chris(Kiwi)




*/

#include <Arduboy2.h>
Arduboy2 arduboy;
Sprites sprites;
unsigned char a,b,c,d,e,f,x,y,
bgx,bgy,tile,scrollx,scrolly,aniframe,
walk,TileID,extendx,extendy,
playerp,playerx,playery,playerf;

unsigned char RoomMap[96];

unsigned char objectID[10],objectx[10],objecty[10],objectp[10],objectb[10];

const unsigned char PROGMEM DungeonGraphic[] = {
16, 16,  
0x77, 0xab, 0xdd, 0xee, 0x77, 0xbb, 0xdd, 0xea, 0x77, 0xbb, 0xdd, 0xaa,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 0x00, 
};

const unsigned char PROGMEM BackpackMan[] = {
// width, height,
16, 16,
0x00, 0x00,0x00, 0x80,0x00, 0x80,0x00, 0xf0,0xb0, 0xf8,0xa0, 0xfe,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 0x00,
0x00, 0x00,0x00, 0x00,0x00, 0x00,0x00, 0xe0,0xa0, 0xf0,0xb0, 0xf8,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 0x00,
0x00, 0x00,0x00, 0x80,0x00, 0x80,0x00, 0xf0,0xb0, 0xf8,0xb0, 0xfe,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 0x00,
0x00, 0x00,0x00, 0x00,0x00, 0x00,0x00, 0xde,0xdc, 0xff,0x10, 0xff,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 0x00

};

const unsigned char PROGMEM EnemyGraphic[] = {
// width, height,
16, 16,
0x00, 0x00,0x00, 0x00,0x00, 0x00,0x00, 0x80,0x80, 0xe0,0x60, 0xf8,0x18, 0xfe,0x86, 0xff,0x82, 0xff,0x00, 0xfe,0x80, 0xfc,0x80, 0xf8,0x00, 0xe0,0x00, 0x80,0x00, 0x00,0x00, 0x00,
0x00, 0x1c,0x00, 0x3e,0x02, 0x3f,0x01, 0x3f,0x00, 0x7f,0x00, 0x7f,0x00, 0x7f,0x08, 0x7f,0x04, 0x7f,0x04, 0x7f,0x04, 0x7f,0x08, 0x7f,0x00, 0x7f,0x00, 0x3f,0x00, 0x3f,0x00, 0x1c,
0x00, 0x00,0x00, 0x00,0x00, 0x00,0x00, 0x80,0x80, 0xc0,0x40, 0xf0,0x30, 0xf8,0x08, 0xfc,0x08, 0xfc,0x00, 0xf8,0x00, 0xf0,0x00, 0xc0,0x00, 0x80,0x00, 0x00,0x00, 0x00,0x00, 0x00,
0x00, 0x1c,0x0c, 0x3e,0x02, 0x7f,0x02, 0x7f,0x01, 0x7f,0x00, 0x7f,0x00, 0x7f,0x02, 0x7f,0x12, 0x7f,0x10, 0x7f,0x12, 0x7f,0x02, 0x7f,0x00, 0x7f,0x00, 0x7f,0x00, 0x3f,0x00, 0x1e

  
};

/*
5,2,2,2,3,2,2,5,5,5,5,5,
5,0,0,0,0,0,0,5,5,5,5,5,
2,0,0,0,0,0,1,2,2,2,2,5,
0,0,0,4,0,0,0,0,0,0,0,5,
5,0,4,4,0,0,1,1,0,0,0,2,
5,0,0,4,0,0,0,1,1,0,0,0,
5,0,0,0,0,0,0,0,0,0,0,5,
5,5,5,5,5,0,5,5,5,5,5,5
*/


const unsigned char sampleMAP[] = {
5,2,2,2,2,2,3,2,2,2,2,5,
5,0,0,0,0,0,0,0,0,0,0,5,
2,0,0,0,0,0,0,0,0,0,0,2,
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5,5,5,5,5,5,0,5,5,5,5,5,


};

void TileIDplayercheck(void){
TileID=x+y*12;  
if(sampleMAP[TileID]!=0){
if(playerp==4){playery++;}  
if(playerp==0){playery--;}
if(playerp==6){playerx++;}
if(playerp==2){playerx--;}
}  
}

void BGcheck(void){
x=(playerx)/16;  
y=(playery+16)/16;
TileIDplayercheck();
x=(playerx+14)/16;  
y=(playery+16)/16;
TileIDplayercheck();
x=(playerx)/16;  
y=(playery+8)/16;
TileIDplayercheck();
x=(playerx+14)/16;  
y=(playery+8)/16;
TileIDplayercheck();
}//4 point collision check.

void setup() {
  // put your setup code here, to run once:
arduboy.boot();
    arduboy.flashlight();//boot+flashlight 1982
    arduboy.clear();
    arduboy.setFrameRate(30);
    arduboy.initRandomSeed();
a=0;
scrolly=128,scrollx=192;
playerx=56,playery=24,playerp=0;

for(uint8_t i=0;i!=96;i++){
RoomMap[i]=pgm_read_byte(sampleMAP+i);
  
}//load tiles to RAM table
for(unsigned char ID=0;ID!=10;ID++){
objectID[ID]=1;objectx[ID]=16+ID*16;objecty[ID]=16;objectb[ID]=0;objectp[ID]=0;
}
}//loops to set up the 10 objects,

void ObjectBehavior(void){
for(unsigned char ID=0;ID!=10;ID++){
switch(objectID[ID]){
case 1:
if(objectb[ID]==0){objecty[ID]++;}
if(objectb[ID]==1){objecty[ID]--;}
if(objecty[ID]==96){objectb[ID]=1;}
if(objecty[ID]==16){objectb[ID]=0;}
if(aniframe==2){objectp[ID]=1;}
if(aniframe==10){objectp[ID]=0;}
break;
  
}//switch
}//for

}//rts
//object behavior, only one entry so far and was suppose to over above set up...

void loop() {
if(!arduboy.nextFrame()){return;}
arduboy.clear();


ObjectBehavior();

if(arduboy.pressed(UP_BUTTON)&&playery>0){playery--;playerp=4;walk++;goto playermove;}
if(arduboy.pressed(DOWN_BUTTON)&&playery<128){playery++;playerp=0;walk++;goto playermove;}
if(arduboy.pressed(LEFT_BUTTON)&&playerx>0){playerx--;playerp=6;walk++;goto playermove;}
if(arduboy.pressed(RIGHT_BUTTON)&&playerx<192){playerx++;playerp=2;walk++;goto playermove;}

playermove:
tile=0;
for(bgy=0;bgy!=(16*8);bgy+=16){
for(bgx=0;bgx!=(16*12);bgx+=16){

sprites.drawOverwrite(bgx-192+scrollx,bgy-128+scrolly,DungeonGraphic,sampleMAP[tile]);
tile++;
}}// This prints the tiles from upper left to bottom right
  //changing the *8 to *12 in bgy will increase the map size to 144 tiles,  but you'll also
  //have to change the array RAM size to 144. Keep in mind TileID is 8-bit, if you need
  //make a bigger map tile count more than 255 bytes, you can change the RAM varible to unsigned int
  //and below, you'll have to change -128+scrolly to -192+scrolly.
  //In this WIP game I'm working with Sprites class
  
sprites.drawPlusMask(playerx-192+scrollx,playery-128+scrolly,BackpackMan,playerp+playerf);
  //your main character.  
for(unsigned char ID=0;ID!=10;ID++){
sprites.drawPlusMask(objectx[ID]-192+scrollx,objecty[ID]-128+scrolly,EnemyGraphic,objectp[ID]);
} //The enemies, they actually stick well on the map. 
if(playery-128+scrolly>=32){scrolly-=1;BGcheck();}
if(playery-128+scrolly<=24){scrolly+=1;BGcheck();}
if(playerx-192+scrollx>=40){scrollx-=1;BGcheck();}
if(playerx-192+scrollx<=72){scrollx+=1;BGcheck();}
//Above pans the screen when the player walks outside the bound invisible box.
//I have trouble telling it not to pan when it is specific spot. like the edge of a map.  

aniframe++;if(aniframe==16){aniframe=0;}
if(walk>=8){walk=0;}

if(walk==0){playerf=0;}
if(walk==4){playerf=1;}
//animation

arduboy.display();

}
